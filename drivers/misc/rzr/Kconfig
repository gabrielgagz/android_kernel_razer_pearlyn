## drivers/misc/rzr/Kconfig
```kconfig
config RZR_DEVMODE
	bool "Razer 'Device Mode' for USB Port"
	depends on ARCH_APQ8084
	default n

config RZR_LED
	bool "Razer Led Control"
	depends on ARCH_APQ8084
	default n

config RZR_FILTER
	bool "Razer Filter for Serval Controller"
	depends on ARCH_APQ8084
	default n

config RZR_HDMI_EDID
	bool "Razer HDMI EDID"
	depends on ARCH_APQ8084
	default n
```
