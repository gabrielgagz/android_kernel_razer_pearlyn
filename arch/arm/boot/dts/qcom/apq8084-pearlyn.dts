/* Copyright (c) 2013-2014, The Linux Foundation. All rights reserved.
 *
 * This program is free software; you can redistribute it and/or modify
 * it under the terms of the GNU General Public License version 2 and
 * only version 2 as published by the Free Software Foundation.
 *
 * This program is distributed in the hope that it will be useful,
 * but WITHOUT ANY WARRANTY; without even the implied warranty of
 * MERCHANTABILITY or FITNESS FOR A PARTICULAR PURPOSE.  See the
 * GNU General Public License for more details.
 */

/dts-v1/;

#include "apq8084-v1.1-pearlyn.dtsi"
#include "apq8084-old-pwr-grid.dtsi"
#include "apq8084-liquid-pearlyn.dtsi"

/ {
	model = "APQ8084 Razer Pearlyn 1";
	compatible = "qcom,apq8084-liquid", "qcom,apq8084", "qcom,liquid";
	qcom,board-id = <9 0xa>;
};

&ufsphy1 {
	status = "disabled";
};

&ufs1 {
	status = "disabled";
};
